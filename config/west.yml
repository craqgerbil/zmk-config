## config/west.yml
```yaml
manifest:
  remotes:
    - name: craqgerbil
      url-base: https://github.com/craqgerbil
    # Additional modules containing boards/shields/custom code can be listed here as well
    # See https://docs.zephyrproject.org/3.2.0/develop/west/manifest.html#projects
  projects:
    - name: zmk
      remote: craqgerbil
      revision: main
      import: app/west.yml
  self:
    path: config
```
